## arch/arm/mach-synaptics/Kconfig
```kconfig
if ARCH_SYNAPTICS

config SYS_SOC
	default "synaptics"

config SYS_VENDOR
	default "synaptics"

choice
	prompt "Synaptics board select"

config TARGET_DOLPHIN
	bool "Synaptics Dolphin SoC"
	select ARM64
	help
	  The Synaptics Dolphin is a ARM64-based SoC with a quad-core Cortex-A73.
	  including UART, SPI, USB2.0 and OTG, NAND, EMMC, USB Ethernet, etc.

config TARGET_PLATYPUS
	bool "Synaptics Platypus SoC"
	select ARM64
	help
	  The Synaptics AS640 is a ARM64-based SoC with a quad-core Cortex-A55.
	  including UART, SPI, USB2.0 and OTG, EMMC, etc.

config TARGET_MYNA2
	bool "Synaptics Myna2 SoC"
	select ARM64
	help
	  The Synaptics Myna2 is a ARM64-based SoC with a quad-core Cortex-A55.
	  including UART, SPI, USB2.0 and OTG, EMMC, etc.
endchoice

source "arch/arm/mach-synaptics/drivers/Kconfig"
source "arch/arm/mach-synaptics/cmd/Kconfig"

source "board/synaptics/myna2/Kconfig"
source "board/synaptics/platypus/Kconfig"
source "board/synaptics/dolphin/Kconfig"

menu "Synaptics Specific Setup"

choice
	prompt "Select fastboot/spi-uboot/usb-uboot"
config SYNA_USB_UBOOT
	bool "Synaptics USB U-Boot support"
	help
	  Enable boot from USB tool including download, burn image through USB

config SYNA_SPI_UBOOT
	bool "synaptics SPI U-Boot support"
	help
	  Support Synaptics fastboot

config SYNA_SUBOOT
	bool "synaptics SUBOOT support"
	help
	  Support Synaptics SUBOOT solution

endchoice

choice
	depends on SYNA_SUBOOT
	prompt "Select emmc/spi/usb"

config SYNA_MMC_SUBOOT
	bool "Synaptics MMC SU-Boot support"
	help
	  Enable boot Linux from eMMC/SD

config SYNA_SPI_SUBOOT
	bool "synaptics SPI SU-Boot support"
	help
	  Enable boot Linux from SPI NOR

config SYNA_USB_SUBOOT
	bool "synaptics USB SU-Boot support"
	help
	  Enable boot Linux from USB tool

endchoice

config USE_IRQ_SYNA
	bool "Support IRQ function of Synaptics' chip"

config SYNA_RESCUE_MODE
    bool "Enable Rescue Mode"
    depends on ARCH_SYNAPTICS
    help
      Rescue Mode provides a minimal, standalone Linux environment
      (initramfs-based) for system recovery when the main OS is
      unbootable or corrupted. It runs entirely in RAM from a
      separate partition and operates independently of the main
      root filesystem.
endmenu

endif
```

## arch/arm/mach-synaptics/cmd/Kconfig
```kconfig
menu "Synaptics specific command line interface"

config CMD_SYNA_BOOTMMC
	bool "Enable boot Linux from eMMC/SD"
	depends on SYNA_MMC_SUBOOT

config CMD_SYNA_BOOTSPI
	bool "Enable boot Linux from SPI NOR"
	depends on SYNA_SPI_SUBOOT

config CMD_SYNA_FDT_UPDATE
	bool "Enable FDT update before booting Kernel"
	depends on SYNA_SUBOOT

config CMD_SYNA_USBLOAD
	bool "Enable loading image from USB slave"
	depends on (SYNA_USB_UBOOT || SYNA_SUBOOT)

config CMD_SYNA_OTP
	bool "Enable OTP operations"
	depends on SYNA_SUBOOT

config CMD_SYNA_MTDPARTS
	bool "Enable MTD parts in version table format"
	depends on SYNA_SPI_SUBOOT

config CMD_SYNA_FLASH
	default y
	bool "Enable Flash command for Synaptics plats"
	depends on (SYNA_DWSPI || CADENCE_XSPI)
endmenu
```

## arch/arm/mach-synaptics/drivers/Kconfig
```kconfig
menu "Synaptics drivers support"
source "arch/arm/mach-synaptics/drivers/plat/Kconfig"
source "arch/arm/mach-synaptics/drivers/mmc/Kconfig"
source "arch/arm/mach-synaptics/drivers/net/Kconfig"
source "arch/arm/mach-synaptics/drivers/usb/Kconfig"
source "arch/arm/mach-synaptics/drivers/pinctrl/Kconfig"
source "arch/arm/mach-synaptics/drivers/pmic/Kconfig"
source "arch/arm/mach-synaptics/drivers/reset/Kconfig"
source "arch/arm/mach-synaptics/drivers/spi/Kconfig"
source "arch/arm/mach-synaptics/drivers/xspi/Kconfig"
source "arch/arm/mach-synaptics/drivers/clk/Kconfig"
source "arch/arm/mach-synaptics/drivers/tee/Kconfig"
source "arch/arm/mach-synaptics/drivers/video/Kconfig"
source "arch/arm/mach-synaptics/drivers/pwm/Kconfig"
source "arch/arm/mach-synaptics/drivers/regulator/Kconfig"
source "arch/arm/mach-synaptics/drivers/usbconsole/Kconfig"
endmenu
```

## arch/arm/mach-synaptics/drivers/pmic/Kconfig
```kconfig
config SYNA_MYNA2_PMIC
	bool "Synaptics Myna2 SoC pmic driver"
	depends on SYNA_SUBOOT && TARGET_MYNA2
	default y

config SYNA_PLATYPUS_PMIC
	bool "Synaptics Platypus SoC pmic driver"
	depends on SYNA_SUBOOT && TARGET_PLATYPUS
	default y

config SYNA_DOLPHIN_PMIC
	bool "Synaptics Dolphin SoC pmic driver"
	depends on SYNA_SUBOOT && TARGET_DOLPHIN
	default y

config SYNA_KLAMATH_PMIC
	bool "Synaptics Klamath SoC pmic driver"
	depends on SYNA_SUBOOT && TARGET_KLAMATH
	default y
```

## arch/arm/mach-synaptics/drivers/video/Kconfig
```kconfig
config VIDEO_SYNA
	bool "Enable Syna Display support"
	depends on ARCH_SYNAPTICS
	depends on VIDEO
	help
		This enables support for Synaptics display for Edge Soc family

config PANEL_CFG
	string "Panel Config file"
	depends on VIDEO_SYNA
	help
		Configures the panel information from Header file provided.

config SYNA_DRM_BRIDGE_LT9611
	bool "Syna driver based LT9611 bridge"
	select VIDEO_BRIDGE
	depends on VIDEO_SYNA
	help
		Configures Syna driver based LT9611 bridge support

config SYNA_WSPANEL_1080P
	bool "syna compatible wspanel 1080p resolution"
	depends on VIDEO_SYNA
	help
	  syna compatible waveshare 13.3 inch 1080P panel
```

## arch/arm/mach-synaptics/drivers/xspi/Kconfig
```kconfig
config CADENCE_XSPI
	bool "Cadence XSPI driver"
	help
	  Enable the Cadence XSPI driver. This driver can be
	  used to access the XSPI devices on platforms embedding this
	  Cadence IP core.
```

## board/efi/efi-arm_app/Kconfig
```kconfig
if EFI_APP

config SYS_BOARD
	default "efi-arm_app"

config SYS_VENDOR
	default "efi"

config SYS_SOC
	default "efi"

config BOARD_SPECIFIC_OPTIONS # dummy
	def_bool y
	imply VIDEO_EFI

config SYS_LDSCRIPT
	default "arch/arm/lib/elf_aarch64_efi.lds"

config QCOM_MDSS_EFI
	bool
	depends on ARM64
	help
	  Code to drive the Qualcomm QCS8300 (Monaco) display hardware
	  directly from the EFI app: RPMh votes, display clocks, DSI0, the
	  DPU and an ADV7535 DSI-to-HDMI bridge.

config VIDEO_QCOM_MDSS_EFI
	bool "HDMI display for the Arduino Monza (QCS8300)"
	depends on ARM64 && VIDEO
	select QCOM_MDSS_EFI
	help
	  Drive the HDMI output of the Arduino Monza board (DSI0 and an
	  ADV7535 bridge) at 1280x720, since Qualcomm's UEFI there provides
	  no graphics output protocol. Bound from an
	  "arduino,monza-efi-hdmi" devicetree node. Scanout stops at
	  ExitBootServices() so the OS display driver starts cleanly.

config VIDEO_QCOM_MDSS_EFI_KEEP_SCANOUT
	bool "Keep the display running into the OS"
	depends on VIDEO_QCOM_MDSS_EFI
	help
	  Leave the display scanning out after ExitBootServices(), so the
	  last image (e.g. a splash logo) stays on screen until the OS
	  display driver takes over. The framebuffer is allocated as EFI
	  reserved memory so the OS never reuses it, and the SMMU stream
	  mapping is left in place; Linux keeps such boot mappings as bypass.
	  No simple-framebuffer is passed to the OS.

	  For the image to survive until the Linux display driver probes,
	  Linux must not turn off the display clocks and power domain as
	  unused before that, e.g. boot with clk_ignore_unused.

config CMD_QCOM_MDSS_PROBE
	bool "mdssprobe command for Qualcomm QCS8300 display bring-up"
	depends on ARM64
	select QCOM_MDSS_EFI
	help
	  Add the 'mdssprobe' command, which runs the QCS8300 (Monaco)
	  display bring-up step by step, printing what it does, and can
	  inspect clocks, RPMh, the i2c bus and the SMMU. This is a
	  bring-up aid and touches hardware owned by the firmware.

endif
```

## board/synaptics/klamath/Kconfig
```kconfig
if TARGET_KLAMATH

config SYS_BOARD
	default "klamath"

config SYS_CONFIG_NAME
	default "klamath"

config SYS_BOARD_FPGA
	bool "Run on FPGA board"
	default n
	help
	  Say Y here to support FPGA.

config SYS_BOARD_VELOCE
	bool "Run on VELOCE board"
	default n
	select SYS_BOARD_FPGA
	help
	  Say Y here to support VELOCE.

endif
```

## configs/dolphin_suboot_defconfig
```kconfig
CONFIG_ARM=y
CONFIG_POSITION_INDEPENDENT=y
# CONFIG_ARM64_SUPPORT_AARCH32 is not set
CONFIG_ARCH_SYNAPTICS=y
CONFIG_SYS_MALLOC_LEN=0x5c800000
CONFIG_ENV_SIZE=0x10000
CONFIG_ENV_OFFSET=0x3ff0000
CONFIG_DM_GPIO=y
CONFIG_DEFAULT_DEVICE_TREE="dolphin-rdk"
CONFIG_OF_LIBFDT_OVERLAY=y
CONFIG_DM_RESET=y
CONFIG_BOOTCOUNT_BOOTLIMIT=3
CONFIG_SYS_LOAD_ADDR=0xcf00000
CONFIG_WATCHDOG_TIMEOUT_MSECS=0
CONFIG_ENV_OFFSET_REDUND=0x4ff0000
CONFIG_SYNA_TZ_MR=y
CONFIG_SYNA_SM=y
CONFIG_SYNA_INCLUDE_SM_FW=y
CONFIG_MMC_DWCMSHC=y
CONFIG_ETH_ROM_MAC=y
CONFIG_SYNA_USB_PHY=y
CONFIG_SYNA_USB_DWC3=y
CONFIG_SYNA_RESET=y
CONFIG_SYNA_DWSPI=y
CONFIG_VIDEO_SYNA=y
CONFIG_PANEL_CFG="haier_800_1280"
CONFIG_DEFAULT_PANEL_DTBO="dolphin-ws-panel-overlay.dtbo"
CONFIG_CMD_SYNA_BOOTMMC=y
CONFIG_CMD_SYNA_FDT_UPDATE=y
CONFIG_CMD_SYNA_OTP=y
CONFIG_SYNA_SUBOOT=y
CONFIG_USE_IRQ_SYNA=y
# CONFIG_EFI_LOADER is not set
CONFIG_SUPPORT_RAW_INITRD=y
CONFIG_BOOTDELAY=0
# CONFIG_ARCH_FIXUP_FDT_MEMORY is not set
CONFIG_USE_BOOTCOMMAND=y
CONFIG_BOOTCOMMAND="bootmmc"
CONFIG_USE_PREBOOT=y
CONFIG_PREBOOT="show_logo;"
CONFIG_DEFAULT_FDT_FILE="test.dts"
# CONFIG_DISPLAY_CPUINFO is not set
# CONFIG_CYCLIC is not set
CONFIG_ARCH_MISC_INIT=y
CONFIG_BOARD_LATE_INIT=y
CONFIG_HUSH_PARSER=y
# CONFIG_BOOTM_NETBSD is not set
# CONFIG_BOOTM_PLAN9 is not set
# CONFIG_BOOTM_RTEMS is not set
# CONFIG_BOOTM_VXWORKS is not set
# CONFIG_CMD_XIMG is not set
# CONFIG_CMD_EXPORTENV is not set
# CONFIG_CMD_IMPORTENV is not set
CONFIG_CMD_NVEDIT_INFO=y
# CONFIG_CMD_LZMADEC is not set
CONFIG_CMD_GPIO=y
CONFIG_CMD_GPT=y
# CONFIG_CMD_LOADB is not set
# CONFIG_CMD_LOADS is not set
CONFIG_CMD_MMC=y
CONFIG_CMD_MMC_SWRITE=y
CONFIG_CMD_USB=y
# CONFIG_CMD_ITEST is not set
# CONFIG_CMD_SOURCE is not set
# CONFIG_CMD_SETEXPR is not set
CONFIG_SYS_DISABLE_AUTOLOAD=y
CONFIG_CMD_DHCP=y
CONFIG_CMD_MII=y
CONFIG_CMD_PING=y
CONFIG_CMD_BOOTCOUNT=y
CONFIG_CMD_CACHE=y
CONFIG_CMD_TIMER=y
CONFIG_CMD_EXT4=y
CONFIG_CMD_EXT4_WRITE=y
CONFIG_CMD_FAT=y
CONFIG_CMD_FS_GENERIC=y
CONFIG_OF_CONTROL=y
CONFIG_ENV_IS_IN_MMC=y
CONFIG_SYS_REDUNDAND_ENVIRONMENT=y
CONFIG_VERSION_VARIABLE=y
CONFIG_NET_SKIP_INIT=y
CONFIG_IP_DEFRAG=y
CONFIG_NET_RANDOM_ETHADDR=y
CONFIG_TFTP_BLOCKSIZE=16352
CONFIG_BOUNCE_BUFFER=y
CONFIG_BOOTCOUNT_LIMIT=y
CONFIG_BOOTCOUNT_ENV=y
CONFIG_CLK=y
CONFIG_USB_FUNCTION_FASTBOOT=y
CONFIG_UDP_FUNCTION_FASTBOOT=y
CONFIG_FASTBOOT_BUF_ADDR=0x10000000
CONFIG_FASTBOOT_BUF_SIZE=0x8000000
CONFIG_FASTBOOT_FLASH=y
CONFIG_FASTBOOT_OEM_RUN=y
CONFIG_GPIO_HOG=y
CONFIG_DWAPB_GPIO=y
CONFIG_FXL6408_GPIO=y
CONFIG_DM_I2C=y
CONFIG_SYS_I2C_DW=y
CONFIG_MISC=y
CONFIG_SUPPORT_EMMC_RPMB=y
CONFIG_SUPPORT_EMMC_BOOT=y
CONFIG_MMC_IO_VOLTAGE=y
CONFIG_MMC_UHS_SUPPORT=y
CONFIG_MMC_HS400_ES_SUPPORT=y
CONFIG_MMC_HS400_SUPPORT=y
CONFIG_MMC_SDHCI=y
CONFIG_MMC_SDHCI_SDMA=y
CONFIG_MTD=y
CONFIG_MTD_NOR_FLASH=y
CONFIG_USE_SYS_MAX_FLASH_BANKS=y
CONFIG_DM_SPI_FLASH=y
CONFIG_SPI_FLASH_MACRONIX=y
CONFIG_SPI_FLASH_SPANSION=y
CONFIG_SPI_FLASH_STMICRO=y
CONFIG_SPI_FLASH_SST=y
CONFIG_SPI_FLASH_WINBOND=y
# CONFIG_SPI_FLASH_USE_4K_SECTORS is not set
CONFIG_PHY_REALTEK=y
CONFIG_ETH_DESIGNWARE=y
CONFIG_PHY=y
CONFIG_PINCTRL=y
CONFIG_DM_REGULATOR=y
CONFIG_DM_REGULATOR_FIXED=y
CONFIG_SPECIFY_CONSOLE_INDEX=y
CONFIG_DM_SERIAL=y
CONFIG_SERIAL_RX_BUFFER=y
CONFIG_SYS_NS16550=y
CONFIG_SPI=y
CONFIG_DM_SPI=y
CONFIG_TEE=y
CONFIG_OPTEE=y
CONFIG_USB=y
CONFIG_DM_USB_GADGET=y
CONFIG_USB_XHCI_HCD=y
CONFIG_USB_XHCI_DWC3=y
CONFIG_USB_DWC3=y
CONFIG_USB_STORAGE=y
CONFIG_USB_GADGET=y
CONFIG_USB_GADGET_MANUFACTURER="Synaptics"
CONFIG_USB_GADGET_VENDOR_NUM=0x18D1
CONFIG_USB_GADGET_PRODUCT_NUM=0x4EE0
CONFIG_USB_GADGET_DWC2_OTG=y
CONFIG_VIDEO=y
CONFIG_BACKLIGHT_GPIO=y
CONFIG_HEXDUMP=y
CONFIG_REGULATOR_RASPBERRYPI_TOUCHSCREEN_ATTINY=y
CONFIG_SYNA_WSPANEL_1080P=y
# CONFIG_OPTEE_LIB is not set
# CONFIG_TOOLS_LIBCRYPTO is not set
# CONFIG_TOOLS_KWBIMAGE is not set
```

## drivers/nvme/Kconfig
```kconfig
# SPDX-License-Identifier: GPL-2.0+
#
# Copyright (C) 2017, Bin Meng <bmeng.cn@gmail.com>

config NVME
	bool "NVM Express device support"
	select BLK
	help
	  This option enables support for NVM Express devices.
	  It supports basic functions of NVMe (read/write).

config NVME_SANDBOX
	bool "Emulated NVMe controller for sandbox"
	depends on NVME && SANDBOX
	default y if SANDBOX
	help
	  This provides an emulated NVMe controller, so that the NVMe driver
	  and the nvme command can be tested without real hardware. It speaks
	  the register and queue interface which the driver expects and keeps
	  the data in a file on the host.

config NVME_APPLE
	bool "Apple NVMe controller support"
	depends on ARCH_APPLE
	select NVME
	help
	  This option enables support for the NVMe storage
	  controller integrated on Apple SoCs.  This controller
	  isn't PCI-based based and deviates from the NVMe
	  standard implementation in its implementation of
	  the command submission queue and the integration
	  of an NVMMU that needs to be managed.

config NVME_PCI
	bool "NVM Express PCI device support"
	depends on PCI
	select NVME
	help
	  This option enables support for NVM Express PCI
	  devices.
```
